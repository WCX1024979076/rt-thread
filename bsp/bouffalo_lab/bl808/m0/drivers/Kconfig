## bsp/bouffalo_lab/bl808/m0/drivers/Kconfig
```kconfig
menu "BL808_M0 Hardware Drivers Config"
config SOC_BL808
    bool
    select RT_USING_COMPONENTS_INIT
    select RT_USING_USER_MAIN
    select ARCH_RISCV_FPU_S
    default y


config BSP_USING_JTAG_M0
    bool "Enable M0 JTAG "
    default n

choice
    prompt "Select bsp type"
    default BSP_BL808
    config BSP_BL602
        bool "Using bl602"

    config BSP_BL616
        bool "Using bl616"

    config BSP_BL702
        bool "Using bl702"

    config BSP_BL808
        bool "Using bl808"
endchoice

if BSP_BL808
    choice
        prompt "Select bl808 cpu id"
        default BL808_M0
        config BL808_M0
            bool "Using m0"

        config BL808_D0
            bool "Using d0"

        config BL808_LP
            bool "Using lp"
    endchoice
endif

menu "On-chip Peripheral Drivers"

    config BSP_USING_GPIO
        bool "Enable GPIO"
        select RT_USING_PIN
        default y

    config BSP_USING_LCD
        bool "Enable LCD"
        select RT_USING_LCD
        default y

    menuconfig BSP_USING_I2C1
        bool "Enable I2C1 BUS (software simulation)"
        default n
        select RT_USING_I2C
        select RT_USING_I2C_BITOPS
        select RT_USING_PIN
        if BSP_USING_I2C1
            config BSP_I2C1_SCL_PIN
                int "i2c1 scl pin number"
                range 0 33
                default 20
            config BSP_I2C1_SDA_PIN
                int "I2C1 sda pin number"
                range 0 33
                default 21
        endif

    menuconfig BSP_USING_SPI
        bool "Enable SPI"
        default y
        select RT_USING_SPI
        if BSP_USING_SPI
            config BSP_USING_SPI0
                bool "Enable SPI0"
                default y

            config BSP_USING_SPI1
                bool "Enable SPI1"
                default y
        endif

    menuconfig BSP_USING_PWM
        bool "Enable PWM"
        default y
        select RT_USING_PWM
        if BSP_USING_PWM
            config BSP_USING_PWM0
                bool "Enable PWM0"
                default y

            config BSP_USING_PWM1
                bool "Enable PWM1"
                default y

            config BSP_USING_PWM2
                bool "Enable PWM2"
                default y

            config BSP_USING_PWM3
                bool "Enable PWM3"
                default y
        endif

    menuconfig BSP_USING_UART
        bool "Enable UART"
        default y
        select RT_USING_SERIAL
        if BSP_USING_UART
            config BSP_USING_UART0
                bool "Enable UART0"
                default y

            if BSP_USING_UART0
                config BSP_UART0_TXD_PIN
                    int "uart0 TXD pin number"
                    default 14

                config BSP_UART0_RXD_PIN
                    int "uart0 RXD pin number"
                    default 15

            endif

        endif
    
    menuconfig BSP_USING_RTC
        bool "Enable RTC"
        select RT_USING_RTC
        default n
    
    config BSP_USING_WDT
        bool "Enable Watchdog Timer"
        select RT_USING_WDT
        default n
endmenu

endmenu
```
